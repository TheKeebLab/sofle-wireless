## module/Kconfig
```kconfig
config ZMK_BEHAVIOR_WHEEL_STEP
    bool
    default y
    depends on DT_HAS_ZMK_BEHAVIOR_WHEEL_STEP_ENABLED && ZMK_POINTING

config ZMK_BEHAVIOR_SCREEN_BRIGHTNESS
    bool
    default y
    depends on DT_HAS_ZMK_BEHAVIOR_SCREEN_BRIGHTNESS_ENABLED
```

## module/dts/bindings/behaviors/zmk,behavior-screen-brightness.yaml
```yaml
description: Screen brightness key. Each press steps both screens to the next level, high, medium, low, high.

compatible: "zmk,behavior-screen-brightness"

include: zero_param.yaml
```

## module/dts/bindings/behaviors/zmk,behavior-wheel-step.yaml
```yaml
description: One mouse-wheel step per press. Param 1 is the signed step (positive = up).

compatible: "zmk,behavior-wheel-step"

include: one_param.yaml
```
